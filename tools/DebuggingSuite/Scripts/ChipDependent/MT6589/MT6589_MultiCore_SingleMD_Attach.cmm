;;;;;;;;;;;;;;;;;;;;;;;;;;;;;;;;;;;;;;;;;;;;;;;;;;;;;;
;; MT6589_MultiCore_SingleMD_Attach.cmm
;;;;;;;;;;;;;;;;;;;;;;;;;;;;;;;;;;;;;;;;;;;;;;;;;;;;;;
GLOBAL &OPT_ELF_PATH
GLOBAL &OPT_SRC_PATH

do MT6589_MD_Info.cmm
IF &OPT_MD_SEL==1
(
    &OPT_ELF_PATH="&OPT_MD1_ELF_PATH"
    &OPT_SRC_PATH="&OPT_MD1_SRC_PATH"
)
ELSE IF &OPT_MD_SEL==2
(
    &OPT_ELF_PATH="&OPT_MD2_ELF_PATH"
    &OPT_SRC_PATH="&OPT_MD2_SRC_PATH"
)

AREA.reset
winpos 0% 0% 70% 50%
AREA
print "== MT6589_MultiCore_SingleMD_Attach.cmm =="
print "OPT_MD_SEL   = &OPT_MD_SEL"
print "OPT_ELF_PATH = &OPT_ELF_PATH"
print "OPT_SRC_PATH = &OPT_SRC_PATH"
print "============================="


&OPT_LOAD_ELF=1

if OS.FILE("&OPT_ELF_PATH")
(
    ; load MD symbols
    print "Loading Modem symbols..."
    print "&OPT_ELF_PATH"
    D.LOAD.ELF &OPT_ELF_PATH /RELPATH /PATH &OPT_SRC_PATH /nocode
    wait 100.ms
)
else
(
    print "can't find &OPT_ELF_PATH"
)

IF &OPT_MD_SEL!=2
(
    do CR4_connect.cmm
)
ELSE IF &OPT_MD_SEL!=1
(
    do ARM9_connect.cmm
)

; Setting attribute of breakpoints
; Setting HW breakpoint by default
Break.Select Program OnChip
Break.Select Hll OnChip
Break.Select Read OnChip
Break.Select Write OnChip

print "Set modem debug mode"
D.S A:0xA011A010 %LE %WORD DATA.LONG(A:0xA011A010)|0x1

; Disable WDT
print "Disable modem WDT"
print "[0x80050000] <- 0x2200"
D.S SD:0x80050000 %LE %WORD 0x2200
; bypass_CTIRQ1_precision_check
; Avoiding assert at CTIRQ1/2
print "L1 Assert Bypass" 
print "[0x83070008] <- 0xABCD"
D.S SD:0x83070008 %LE %WORD 0xABCD
print "[0x83070010] <- 0x0003"
D.S SD:0x83070010 %LE %WORD 0x0003     ; bit0: disable CTIRQ1/2 timing check


winclear
winpos 0% 0% 50% 40%
d.l

winpos 0% 40% 50% 30%
sYmbol.Browse

winpos 0% 70% 50% 30%
Break.List

winpos 50% 0% 50% 40%
Register

winpos 50% 40% 50% 30%
Var.Frame /l /c

winpos 50% 70% 50% 30%
area

menu.reprogram Bring-up_Magic

IF &OPT_MD_SEL==1
(
    menu.reprogram Cortex-R_MPU_View
)
;; workaournd for burst read issue
MemMap.MemRange 0xA0000000--0xAFFFFFFF ReadWrite W32

; Nucleus Debugging Tool
GLOBAL &DBGSUITE_PATH
&DBGSUITE_PATH="&OPT_MD_SRC_PATH\tools\DebuggingSuite"

if version.build()==0x100000 
(
	task.config &DBGSUITE_PATH\Misc\NUCLEUS
)
else
(
	if y.exist(TCT_Schedule)
	(
		task.config &DBGSUITE_PATH\Misc\NUCLEUS
		menu.reprogram &DBGSUITE_PATH\Misc\NUCLEUS
	)
	else
	(
		task.config &DBGSUITE_PATH\Misc\NUCLEUS_V2
		menu.reprogram &DBGSUITE_PATH\Misc\NUCLEUS_V2
	)
)

if "&OPT_RESET"=="ATTACH"
(
    print "Modem is attached! you can start debugging now!"
)



;;;;;;;;;;;;;;;;;;;;;;;;;;;;;;;;;;;;;;;;;;;;;;;;;;;;;;;;;;;;;;;;;;;;;;;;;;
;
; File:         MT6589_MultiCore_AP.cmm
;
; Description:  For MT6589 AP reset and go/attach
;
;;;;;;;;;;;;;;;;;;;;;;;;;;;;;;;;;;;;;;;;;;;;;;;;;;;;;;;;;;;;;;;;;;;;;;;;;;

ENTRY &OPT_RESET

&OPT_AP_DEBUG=0 ; set 1 if at ap side

; Show CVD information window
winpos 0% 0% 50% 50%
AREA
print "== MT6589_MultiCore_AP.cmm =="
print "OPT_MD_SEL = &OPT_MD_SEL"
print "OPT_RESET = &OPT_RESET"
print "============================="


print "[Step 2] Press enter to continue master..."
enter &nop

; CodeViser setting for Cortex-A7
do CA7_connect.cmm &OPT_RESET
wait 100.ms

; Setting attribute of breakpoints
; Setting HW breakpoint by default
Break.Select Program OnChip
Break.Select Hll OnChip
Break.Select Read OnChip
Break.Select Write OnChip

; Set bit0 for CCCI wait handshake forever
print "Set modem debug mode"
print "[0x1011A010] <- 0x1"
D.S A:0x1011A010 %LE %WORD DATA.LONG(A:0x1011A010)|0x1


; Disable DABORT and PABORT breakpoint
tronchip.set dabort off
tronchip.set pabort off
tronchip.set undef  off

; 
; Linux kernel init
;

&KernelPath="../../../../kernel/out"

if OS.FILE(&KernelPath/vmlinux)
(
    print "loading Linux kernel symbols..."
    Data.LOAD.Elf &KernelPath/vmlinux /gnu /nocode
    wait 100.ms
)
else
(
    print "can't find vmlinux"
    IF &OPT_AP_DEBUG==1
    (
        Dialog.file *.elf
        entry &elf
        if OS.FILE("&elf")
        (
            Data.LOAD.Elf "&elf" /gnu /nocode
            wait 100.ms
        )
    )
)

y.spath.reset
y.spath.srd &KernelPath/init
y.spath.srd &KernelPath/mm
y.spath.srd &KernelPath/kernel
y.spath.srd &KernelPath/kernel/irq
y.spath.srd &KernelPath/arch/arm/kernel
y.spath.srd &KernelPath/arch/arm/mm
y.spath.srd &KernelPath/arch/arm/lib
y.spath.srd &KernelPath/lib
y.spath.srd &KernelPath/drivers/serial


; Setup Linx awareness
TASK.CONFIG linux       ; loads Linux awareness (linux.t32)
MENU.ReProgram linux    ; loads Linux menu (linux.men)
HELP.FILTER.Add rtoslinux  ; add linux awareness manual to help filter

menu.reprogram AP_Debug; loads Linux menu (linux.men)

IF "&OPT_RESET"=="RESET"
(
    
    ; Wait AP CCCI load modem
    print "wait 20s until CCCI power on modem..."
    go
    wait 20.s
    break
    
    ; 7. Set PLL for MD1
    IF &OPT_MD_SEL!=2
    (
        print "Set MD1 PLL, please wait ..."    ;MT6589 bug
        do MT6589_MD1_PLL_INIT.cmm
    )
)
go
;break
; Disable wdt
;print "Disable AP WDT"
;print "[0x10000000] <- 0x22000024"
;D.S c:0x10000000 %le %long 0x22000024

;synch.on
;synch.masterGo.on
;synch.masterBrk.on
;synch.slaveGo.on
;synch.slaveBrk.on

print "[Step 3]"
print "    Please switch to MD side CVD to continue debugging..."

break

enddo

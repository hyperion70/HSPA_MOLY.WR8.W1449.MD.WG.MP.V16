ENTRY &OPT_RESET

;;;;;;;;;;;;;;;;;;;;;;;;;;
;; CA7_connect.cmm
;;;;;;;;;;;;;;;;;;;;;;;;;;

winclear
AREA.reset
winpos 0% 0% 30% 53%
AREA
&NR_CPUS=1

SYStem.reset
IF "&OPT_RESET"=="RESET" ; Default input: RESET
(
    SYStem.OPTION ENRESET ON
)
ELSE
(
    SYStem.OPTION ENRESET OFF
)

IF &OPT_JTAG==0 ; 0: Parallel
(
	SYStem.Option ResBreak ON
	SYStem.Option WaitReset OFF
	System.CONFIG SWDP OFF
)
else
(
	&NR_CPUS=1
	SYStem.Option TRST OFF
	SYStem.Option ResBreak OFF
	SYStem.Option WaitReset ON
	System.CONFIG SWDP ON  
)

SYStem.JtagClock 10.MHz
SYStem.CPU CortexA7MPCore

;Setting Core debug register access
if &NR_CPUS==1
(
    SYStem.CONFIG CORENUMBER &NR_CPUS
    SYStem.CONFIG COREBASE 0x80070000
)
else
(
    SYStem.CONFIG CORENUMBER &NR_CPUS
    SYStem.CONFIG COREBASE 0x80070000 0x80072000
)

;=================================================
; Attach and Stop CPU
;=================================================
SYStem.Up
MMU.OFF
D.S C15:0x1 0				; Turn off MMU

wait 200.us

SETUP.IMASKHLL ON
SETUP.IMASKASM ON

; Disable DABORT and PABORT breakpoint
TrOnchip.Set dabort off
TrOnchip.Set pabort off
TrOnchip.Set undef off
TrOnchip.Set irq off


; set_hw_breakpoint_by_def
; setting attribute of breakpoints
Break.Select Program OnChip
Break.Select Hll OnChip
Break.Select Spot OnChip
Break.Select Read OnChip
Break.Select Write OnChip


;; Set base addresses
&OPT_MD_START_ADDRESS=0x80000000
&AP_APB_BASE=0x10000000
&MD_WDT_BASE=0x20050000

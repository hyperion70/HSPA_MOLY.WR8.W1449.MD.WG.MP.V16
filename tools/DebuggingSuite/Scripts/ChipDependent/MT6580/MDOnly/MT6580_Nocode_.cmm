;;================================================
;; CHIP:        MT6571
;; PURPOSE:     AP Main Flow
;; CREATE_DATE: 2013/01/25
;; LAST UPDATE: 2013/02/22
;; TESTED:      YES (FPGA)
;;================================================
;;-> <<< Parameters >>>
;;================================================
;; Constant
;;================================================
;;-> # Constant: Platform Parameters
&CONST_DRAM_PHYS_START=0x80100000

;;================================================
;; Options
;;================================================
;;-> # Option: Serial Wire or Parallel JTAG
;; OPT_JTAG
;; 0: Parallel
;; 1: Serial Wire
;;&OPT_JTAG=0

;;-> # Option: DRAM Parameters
;; OPT_DRAM_TYPE
;; 0: FPGA
;; 1: LPDDR1-400
;; 2: LPDDR2-400
;; 3: LPDDR2-533
;; 4: PCDDR3-667
&OPT_DRAM_TYPE=2

;; OPT_DRAM_SIZE (Affect kernel ram usage)
&OPT_DRAM_SIZE=0x20000000

;;-> # Option: Fake BootROM <for FPGA Only>
;; OPT_FAKE_BOOTROM
;; 0: Disable
;; 1: Enable
&OPT_FAKE_BOOTROM=0

;;-> # Option: Number of CPUs to be Connected
;; OPT_NR_CPUS
;; 1: Core0
;; 2: Core0 & Core1
&OPT_NR_CPUS=2

;;================================================
;; Control Code
;;================================================
;;->
;;-> <<< Control Code >>>
;;-> @ APMCU Connection
IF 1==1
(
SYStem.RESet
SYStem.Option ENRESET ON
SYStem.Option ResBreak OFF
SYStem.Option WaitReset OFF

SYStem.JtagClock 10.MHz

SYStem.CPU CortexA7MPCore

IF &OPT_JTAG==0
(
    System.CONFIG SWDP OFF
)
ELSE IF &OPT_JTAG==1
(
    System.CONFIG SWDP ON
)

IF &OPT_NR_CPUS==1
(
    SYStem.CONFIG CORENUMBER 1
    SYStem.CONFIG COREBASE 0x80070000
)
ELSE
(
    SYStem.CONFIG CORENUMBER 2
    SYStem.CONFIG COREBASE 0x80070000 0x80072000
)

SYStem.Up
)


;; disable mmu
D.S C15:0x1 0

;;-> @ APMCU Environment Setting
;; disable WDT
d.s c:0x10007000 %le %long 0x22000064

;;-> @ CTP Ram Booting
DO HWConfig\MT6580_AP_ETT.cmm

;; disable WDT
d.s c:0x10007000 %le %long 0x22000064
; remap
d.s C:0x10001300 1

    GO
    wait 2.s
    break

; remap
d.s C:0x10001300 1


SET_END:
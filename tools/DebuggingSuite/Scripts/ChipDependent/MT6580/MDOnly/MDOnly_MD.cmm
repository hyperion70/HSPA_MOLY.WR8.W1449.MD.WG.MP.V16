ENTRY &opt_reset
;; MT6571_MDOnly_MD.cmm

;;;;;;;;;;;;;;;;;;;;;;;;;;;;;;;;;;;;;;;;;;;;;;;;;;;;;;;;;;;;;;;;;;;;;;
;;;;;     START Cortex-R4 VIEW                                   ;;;;;
;;;;;;;;;;;;;;;;;;;;;;;;;;;;;;;;;;;;;;;;;;;;;;;;;;;;;;;;;;;;;;;;;;;;;;
do Common\CR4_connect.cmm &opt_reset


IF &OPT_CFG_UART_GPIO==1
(
    ;; Set MD related GPIO for AP_SETTING==1 (AP setting done by CMM)
    DO HWConfig\MT6580_MD_UART_SetGPIO.cmm
)
IF &OPT_CFG_SIM_GPIO==1
(
    DO HWConfig\MT6580_MD_SIM_SetGPIO.cmm
)
IF &OPT_CFG_L1_RF_GPIO==1
(
    DO HWConfig\MT6580_MD_L1_RF_SetGPIO.cmm
)

;confirm vend_mac.lu(Chun Fan provide information)
;(confirm via TOPRGU data sheet)
; Disable AP WDT
print "Disable AP MD WDT"
D.S SD:(0xA0007000) %LE %LONG 0x22000000

;(confirm via MD_RGU data sheet)
; Disable WDT
print "Disable MD WDT"
print "[0x&MD_WDT_BASE] <- 0x2200"
D.S SD:(&MD_WDT_BASE+0x0000) %LE %WORD 0x2200

;(confirm data sheet Dual Mode Baseband Serial Interface and L1D_Init0())
; bypass_CTIRQ1_precision_check
; Avoiding assert at CTIRQ1/2
print "L1 Assert Bypass" 
print "BSI [0x83070008] <- 0xABCD"
D.S SD:0x83070008 %LE %WORD 0xABCD
print "BSI [0x83070010] <- 0x0003"
D.S SD:0x83070010 %LE %WORD 0x0003     ; bit0: disable CTIRQ1/2 timing check

;(confirm via MD_CONFIG data sheet)
; Remap CR4 bank F to bank 0 (Clear MD_MCU_CON0 bit31~30)
IF &AP_SETTING!=3
(
print "CR4 Bank F map to Bank 0"
D.S SD:0x80000100 %LE %LONG DATA.LONG(SD:0x80000100)&0x3FFFFFFF
)
;(confirm with YH Peng)
print "MD Boot Mode" 
print "[0x80000010] <- &OPT_MD_BOOT_MODE"
; Boot Mode
D.S SD:(0x80000010) %LE %LONG &OPT_MD_BOOT_MODE

IF &AP_SETTING==0
(
	;don't need to wait TinyBootloader.
)
else
(
	IF &AP_SETTING==3
	(
		print "Wait 8s for TinyBootloader ..."
		wait 8.s
	)
	else
	(
		print "Wait 4s for TinyBootloader ..."
		wait 4.s
	)

)
IF &OPT_LOAD_ELF==1
(
    print "Load MD ELF(Symbol Only)..."
    D.LOAD.ELF &OPT_MD_ELF_PATH /RELPATH /PATH &OPT_MD_SRC_PATH /nocode
)

IF &OPT_LOAD_ELF==2
(
    print "Load MD ELF(Download)..."
    D.LOAD.ELF &OPT_MD_ELF_PATH /RELPATH /PATH &OPT_MD_SRC_PATH
)

IF &OPT_CFG_TCM==1
(
    local &OPT_ITCM_ADDR
    local &OPT_DTCM_ADDR
    &OPT_ITCM_ADDR="0x"+Format.Hex(8, Image$$INTSRAM_CODE$$Base)
    &OPT_DTCM_ADDR="0x"+Format.Hex(8, Image$$INTSRAM_PHYSICAL_BOUNDARY$$Base)
    print "Configure TCM ..."
    print "ITCM &OPT_ITCM_ADDR"
    ; Set BTCM Address
    d.s C15:0x0019 %LE %LONG (&OPT_ITCM_ADDR|1)
    print "DTCM &OPT_DTCM_ADDR"
    ; Set ATCM Address
    d.s C15:0x0119 %LE %LONG (&OPT_DTCM_ADDR|1)
)

IF &OPT_CFG_CACHE==1
(
    print "Configure Cache ... (Enable)"
    d.s C15:0x0001 %LE %LONG (data.long(C15:0x0001)|(1<<2)|(1<<0xc))
)

IF &OPT_CFG_MPU==1
(
    print "Configure MPU ... (Enable)"
    do "Cortex-R_MPU_Bushang_Recover.cmm"
)

IF &OPT_CFG_PLL==1
(
    print "Configure MD PLL ..."
    do "md_pll_init.cmm"
)

;; RamDisk Handling
DO MDOnly\Ramfs_config.cmm


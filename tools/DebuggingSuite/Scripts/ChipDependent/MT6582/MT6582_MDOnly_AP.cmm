
IF &AP_SETTING==0
(
    ;; CMM Only Case
    PRINT "This way is not implemented..."
    END
)
ELSE IF &AP_SETTING==1
(
    ;; Tiny bootloader ELF image downloaded by CVD case
    DO CA7_connect.cmm RESET
    
    wait 200.us

    ;; Disable WDT
    Data.Set c:0x10007000 %le %long 0x22000000

    PRINT "Load Preloader"
    D.LOAD.BINARY &OPT_TINY_BOOTLOADER_BIN 0x201000 /noclear
    Register.Set PC 0x201000
    Register.Set T 0 ; must
    
    PRINT "Wait preloader Enter while(1);"
    GO
    WAIT 1s

    Break
    Data.Test a:0x80000000--a:0x80001000 /Random

    PRINT "Done"
)

ENDDO
